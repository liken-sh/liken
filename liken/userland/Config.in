## liken/userland/bluetooth/bluez-static/Config.in
```kconfig
config BR2_PACKAGE_BLUEZ_STATIC
	bool "bluez-static"
	depends on BR2_USE_WCHAR # libglib2
	depends on BR2_TOOLCHAIN_HAS_THREADS # dbus, libglib2
	select BR2_PACKAGE_DBUS
	select BR2_PACKAGE_LIBGLIB2
	select BR2_PACKAGE_READLINE
	help
	  bluetoothd, bluetoothctl, btmon, and btmgmt, linked static,
	  with the patches in this directory applied.

	  buildroot's bluez5_utils recipe needs shared libraries,
	  because bluetoothd can load plugins with dlopen. The plugins
	  that the bluetoothd image needs are built into bluetoothd,
	  and musl's static dlopen fails at run time, so the static
	  build loads no outside plugin.

	  https://www.bluez.org
```

## liken/userland/iscsi/libkmod-static/Config.in
```kconfig
config BR2_PACKAGE_LIBKMOD_STATIC
	bool "libkmod-static"
	help
	  libkmod, the kernel module library of kmod, as a static
	  archive. iscsid links it to check that iscsi_tcp is loaded.

	  buildroot's kmod recipe needs shared libraries, because kmod's
	  build names libkmod a shared library. This recipe builds the
	  library alone, with a patch that lets meson's default_library
	  choose the kind.

	  https://git.kernel.org/pub/scm/utils/kernel/kmod/kmod.git
```

## liken/userland/iscsi/open-iscsi-static/Config.in
```kconfig
config BR2_PACKAGE_OPEN_ISCSI_STATIC
	bool "open-iscsi-static"
	select BR2_PACKAGE_LIBKMOD_STATIC
	select BR2_PACKAGE_OPENSSL
	select BR2_PACKAGE_UTIL_LINUX
	select BR2_PACKAGE_UTIL_LINUX_LIBMOUNT
	help
	  iscsid and iscsiadm, the iSCSI initiator, linked static.

	  buildroot's open-iscsi recipe needs shared libraries, because
	  it links buildroot's kmod and because open-iscsi's build names
	  its own library a shared library. This recipe links
	  libkmod-static, and a patch lets meson's default_library
	  choose the kind of open-iscsi's library.

	  https://github.com/open-iscsi/open-iscsi
```
